## boards/arm/open_scoreboard_nrf52832/Kconfig.board
```kconfig
# Copyright (c) 2024 Nordic Semiconductor ASA
# SPDX-License-Identifier: Apache-2.0

config BOARD_OPEN_SCOREBOARD_NRF52832
	bool "Open Scoreboard nRF52832"
	depends on SOC_NRF52832_QFAA
```

## boards/arm/open_scoreboard_nrf52832/Kconfig.defconfig
```kconfig
# Copyright (c) 2024 Nordic Semiconductor ASA
# SPDX-License-Identifier: Apache-2.0

if BOARD_OPEN_SCOREBOARD_NRF52832

config BOARD
	default "open_scoreboard_nrf52832"

config BT_CTLR
   default BT


endif
```

## boards/arm/open_scoreboard_nrf52832/open_scoreboard_nrf52832_defconfig
```kconfig
# Copyright (c) 2024 Nordic Semiconductor ASA
# SPDX-License-Identifier: Apache-2.0

CONFIG_SOC_SERIES_NRF52X=y
CONFIG_SOC_NRF52832_QFAA=y
CONFIG_BOARD_OPEN_SCOREBOARD_NRF52832=y

# Enable MPU
CONFIG_ARM_MPU=y

# Enable hardware stack protection
CONFIG_HW_STACK_PROTECTION=y

#enable GPIO
CONFIG_GPIO=y

# additional board options
CONFIG_GPIO_AS_PINRESET=y

# for when the custom board doesn't have an LF crystal
CONFIG_CLOCK_CONTROL_NRF_K32SRC_RC=y

# Enable RTT
CONFIG_USE_SEGGER_RTT=y

# enable uart driver
CONFIG_SERIAL=y

# enable console
CONFIG_CONSOLE=y
CONFIG_UART_CONSOLE=y

# additional board options
CONFIG_GPIO_AS_PINRESET=y

CONFIG_PINCTRL=y

CONFIG_PWM=y
```
